#include <stddef.h>

#include "Fonts.h"
#include "LcdDisplay.h"
#include "LcdBuffer.h"
#include "hal_lcd.h"

#define TIME_DIGIT_HEIGHT ( 19 )
/* actual width is 11 but they are stored in 16 bit container */
#define TIME_DIGIT_WIDTH       ( 16 )

const unsigned char Alphabet8w10h[96][10];
const unsigned char pTimeDigit[10*2][19*2];
const unsigned char pTimeColonR[1][19*1];
const unsigned char pTimeColonL[1][19*1];

extern tLcdLine pMyBuffer[NUM_LCD_ROWS];

unsigned char const* GetPointerForTimeDigit(unsigned char Digit,
                                                   unsigned char Offset)
{
  if ( Digit > 10 )
  {
    //PrintString("Invalid input to GetPointerForTimeDigit\r\n");
    return pTimeDigit[0];
  }

  return (pTimeDigit[Digit+Offset]);
}


void InitMyBuffer(void)
{
  int row;
  int col;

  // Clear the display buffer.  Step through the rows
  for(row = STARTING_ROW;
      ((row < NUM_LCD_ROWS) && (row < NUM_LCD_ROWS)); row++)
  {
      // clear a horizontal line
      for(col = 0; col < NUM_LCD_COL_BYTES; col++)
      {
        pMyBuffer[row].Row = row+FIRST_LCD_LINE_OFFSET;
        pMyBuffer[row].Data[col] = 0x00;
        pMyBuffer[row].Dummy = 0x00;

      }
  }
}

void FillMyBuffer(unsigned char StartingRow,
                         unsigned char NumberOfRows,
                         unsigned char FillValue)
{
  int row = StartingRow;
  int col;

  // Clear the display buffer.  Step through the rows
  for( ; row < NUM_LCD_ROWS && row < StartingRow+NumberOfRows; row++ )
  {
    // clear a horizontal line
    for(col = 0; col < NUM_LCD_COL_BYTES; col++)
    {
      pMyBuffer[row].Data[col] = FillValue;
    }
  }
}


unsigned char const* GetSpritePointerForChar(unsigned char CharIn)
{
  return (Alphabet8w10h[MapCharacterToIndex(CharIn)]);
}

 unsigned char const* GetSpritePointerForDigit(unsigned char Digit)
{
  return (Alphabet8w10h[MapDigitToIndex(Digit)]);
}



void CopyRowsIntoMyBuffer(unsigned char const* pImage,
                                 unsigned char StartingRow,
                                 unsigned char NumberOfRows)
{

  unsigned char DestRow = StartingRow;
  unsigned char SourceRow = 0;
  unsigned char col = 0;

  while ( DestRow < NUM_LCD_ROWS && SourceRow < NumberOfRows )
  {
    for(col = 0; col < NUM_LCD_COL_BYTES; col++)
    {
      pMyBuffer[DestRow].Data[col] = pImage[SourceRow*NUM_LCD_COL_BYTES+col];
    }

    DestRow++;
    SourceRow++;

  }

}

/* sprites are in the form row,row,row */
void WriteSpriteChar(unsigned char Char,
                            unsigned char RowOffset,
                            unsigned char ColumnOffset)
{

  /* copy Char into correct position */
  unsigned char const * pChar = GetSpritePointerForChar(Char);
  unsigned char RowNumber;
  unsigned char left = 0;

  for ( RowNumber = 0; RowNumber < 10; RowNumber++ )
  {
    pMyBuffer[RowNumber+RowOffset].Data[left+ColumnOffset] = pChar[RowNumber];
  }

}

unsigned char WriteString(unsigned char *pString,
                          unsigned char RowOffset,
                          unsigned char ColumnOffset,
                          unsigned char AddSpace)
{
  unsigned char i = 0;
  unsigned char character = pString[i];

  while (   ((i+ColumnOffset) < NUM_LCD_COL_BYTES)
         && character != 0 )
  {
    WriteSpriteChar(pString[i],RowOffset,ColumnOffset+i);

    character = pString[i++];
  }

  return ColumnOffset+i+AddSpace-1;

}

void CopyColumnsIntoMyBuffer(unsigned char const* pImage,
                                    unsigned char StartingRow,
                                    unsigned char NumberOfRows,
                                    unsigned char StartingColumn,
                                    unsigned char NumberOfColumns)
{
  unsigned char DestRow = StartingRow;
  unsigned char RowCounter = 0;
  unsigned char DestColumn = StartingColumn;
  unsigned char ColumnCounter = 0;
  unsigned int SourceIndex = 0;
  if(pImage == NULL) return; // HMMMM?


  /* copy rows into display buffer */
  while ( DestRow < NUM_LCD_ROWS && RowCounter < NumberOfRows )
  {
    DestColumn = StartingColumn;
    ColumnCounter = 0;
    while ( DestColumn < NUM_LCD_COL_BYTES && ColumnCounter < NumberOfColumns )
    {
      pMyBuffer[DestRow].Data[DestColumn] = pImage[SourceIndex];

      DestColumn++;
      ColumnCounter++;
      SourceIndex++;
    }

    DestRow++;
    RowCounter++;
  }

}



void PrepareMyBufferForLcd(unsigned char StartingRow,
                                  unsigned char NumberOfRows)
{
  int row = StartingRow;
  int col;

  /*
   * flip the bits before sending to LCD task because it will
   * dma this portion of the screen
  */
  if ( QueryInvertDisplay() == NORMAL_DISPLAY )
  {
    for( ; row < NUM_LCD_ROWS && row < StartingRow+NumberOfRows; row++)
    {
      for(col = 0; col < NUM_LCD_COL_BYTES; col++)
      {
        pMyBuffer[row].Data[col] = ~(pMyBuffer[row].Data[col]);
      }
    }
  }

}




/* sprites are in the form row,row,row */

/* shift only works for blank pixels
 * a real shift will require an OR operation
 */
void WriteSpriteDigit(unsigned char Digit,
                             unsigned char RowOffset,
                             unsigned char ColumnOffset,
                             signed char ShiftAmount)
{

  /* copy digit into correct position */
  unsigned char const * pDigit = GetSpritePointerForDigit(Digit);
  unsigned char RowNumber;
  unsigned char left = 0;
  unsigned char BitMap;

  for ( RowNumber = 0; RowNumber < 10; RowNumber++ )
  {
    if ( ShiftAmount >= 0 )
    {
      BitMap = (pDigit[RowNumber] << ShiftAmount);
    }
    else
    {
      BitMap = (pDigit[RowNumber] >> (ShiftAmount*-1));
    }

    pMyBuffer[RowNumber+RowOffset].Data[left+ColumnOffset] = (BitMap);
  }
}



/*
 * the system font for the digits used for time are 19 high
 */
void WriteTimeDigit(unsigned char Digit,
                           unsigned char RowOffset,
                           unsigned char ColumnOffset,
                           unsigned char JustificationOffset)
{

  /* copy digit into correct position */
  unsigned char const * pDigit = GetPointerForTimeDigit(Digit,JustificationOffset);
  unsigned char RowNumber;
  unsigned char Column;

  for ( Column = 0; Column < 2; Column++ )
  {
    /* RowNumber is the row in the pDigit */
    for ( RowNumber = 0; RowNumber < TIME_DIGIT_HEIGHT; RowNumber++ )
    {
      /* data is ORED in because the 11 bit wide letters are right or left
       * justified in 16 bit containers */
      pMyBuffer[RowNumber+RowOffset].Data[Column+ColumnOffset] |=
        BitRev8(pDigit[RowNumber+(Column*TIME_DIGIT_HEIGHT)]);
    }
  }

}

void WriteTimeColon(unsigned char RowOffset,
                           unsigned char ColumnOffset,
                           unsigned char Justification)
{

  unsigned char RowNumber;
  unsigned char Column = 0;

  /* copy digit into correct position */
  unsigned char const * pDigit;
  if ( Justification == LEFT_JUSTIFIED )
  {
    pDigit = pTimeColonL[0];
  }
  else
  {
    pDigit = pTimeColonR[0];
  }

  /* colon has only one column of non-zero data*/
  for ( RowNumber = 0; RowNumber < TIME_DIGIT_HEIGHT; RowNumber++ )
  {
    /* data is ORED in because the 11 bit wide letters are right or left
     * justified in 16 bit containers */
    pMyBuffer[RowNumber+RowOffset].Data[Column+ColumnOffset] |=
      BitRev8(pDigit[RowNumber+(Column*TIME_DIGIT_HEIGHT)]);
  }
}



void AddDecimalPoint8w10h(unsigned char RowOffset,
                                 unsigned char ColumnOffset)
{
  /* right most pixel is most significant bit */
  pMyBuffer[RowOffset+8].Data[ColumnOffset+1] |= 0x01;

}






/* add a '/' between the month and day */
void DisplayDataSeparator(unsigned char RowOffset,
                                 unsigned char ColumnOffset)
{
  /* right most pixel is most significant bit */
  pMyBuffer[RowOffset+0].Data[ColumnOffset+1] |= BitRev8(0x04);
  pMyBuffer[RowOffset+1].Data[ColumnOffset+1] |= BitRev8(0x02);
  pMyBuffer[RowOffset+2].Data[ColumnOffset+1] |= BitRev8(0x02);
  pMyBuffer[RowOffset+3].Data[ColumnOffset+1] |= BitRev8(0x02);
  pMyBuffer[RowOffset+4].Data[ColumnOffset+1] |= BitRev8(0x02);
  pMyBuffer[RowOffset+5].Data[ColumnOffset+1] |= BitRev8(0x01);
  pMyBuffer[RowOffset+6].Data[ColumnOffset+1] |= BitRev8(0x01);
  pMyBuffer[RowOffset+7].Data[ColumnOffset+1] |= BitRev8(0x01);
  pMyBuffer[RowOffset+8].Data[ColumnOffset+1] |= BitRev8(0x01);
  pMyBuffer[RowOffset+9].Data[ColumnOffset]   |= BitRev8(0x80);

}

/* these items are 4w*10h */
void WriteFoo(unsigned char const * pFoo,
                     unsigned char RowOffset,
                     unsigned char ColumnOffset)
{

  /* copy digit into correct position */
  unsigned char RowNumber;
  unsigned char Column;

  for ( Column = 0; Column < 4; Column++ )
  {
    for ( RowNumber = 0; RowNumber < 10; RowNumber++ )
    {
      pMyBuffer[RowNumber+RowOffset].Data[Column+ColumnOffset] =
        BitRev8(pFoo[RowNumber+(Column*10)]);
    }
  }

}




const unsigned char pMetaWatchSplash[NUM_LCD_ROWS*NUM_LCD_COL_BYTES] =
{
    0x00,0x00,0x00,0x00,0x00,0x00,0x00,0x00,0x00,0x00,0x00,0x00,
    0x00,0x00,0x00,0x00,0x00,0x00,0x00,0x00,0x00,0x00,0x00,0x00,
    0x00,0x00,0x00,0x00,0x00,0x00,0x00,0x00,0x00,0x00,0x00,0x00,
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    0x00,0x00,0x00,0x00,0x00,0x00,0x00,0x00,0x00,0x00,0x00,0x00,
};

const unsigned char Alphabet8w10h[96][10] =
{
    0x00,0x00,0x00,0x00,0x00,0x00,0x00,0x00,0x00,0x00,
    0x00,0x00,0x08,0x1c,0x1c,0x08,0x08,0x00,0x08,0x00,
    0x00,0x00,0x36,0x36,0x24,0x00,0x00,0x00,0x00,0x00,
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    0x00,0x00,0x00,0x12,0x00,0x00,0x12,0x0c,0x00,0x00,
};

 /* This is the system font for the time
  * The characters are 11w*19h but they are
  * in 16 bit containers the first are
  * left justified and the second group are right justified.
  * 10*2*2 = 40 rows of 19
  */
 const unsigned char pTimeDigit[10*2][19*2] =
 {
 0xFC,0xFE,0xFF,0xFF,0x8F,0x8F,0x8F,0x8F,0x8F,0x8F,0x8F,0x8F,0x8F,0x8F,0x8F,0xFF,0xFF,0xFE,0xFC,
 0x01,0x03,0x07,0x07,0x07,0x07,0x07,0x07,0x07,0x07,0x07,0x07,0x07,0x07,0x07,0x07,0x07,0x03,0x01,
 0xE0,0xF0,0xFC,0xFC,0xFC,0xFC,0xF0,0xF0,0xF0,0xF0,0xF0,0xF0,0xF0,0xF0,0xF0,0xF0,0xF0,0xF0,0xF0,
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 0x1F,0x3F,0x7F,0x7F,0x78,0x78,0x78,0x78,0x7F,0x7F,0x7F,0x7F,0x78,0x78,0x7C,0x3F,0x3F,0x1F,0x07,
 };

 const unsigned char pTimeColonR[1][19*1] =
 {
 0x00,0x00,0x00,0x00,0x30,0x78,0x78,0x30,0x00,0x00,0x00,0x30,0x78,0x78,0x30,0x00,0x00,0x00,0x00,
 };

 const unsigned char pTimeColonL[1][19*1] =
 {
 0x00,0x00,0x00,0x00,0x0C,0x1E,0x1E,0x0C,0x00,0x00,0x00,0x0C,0x1E,0x1E,0x0C,0x00,0x00,0x00,0x00,
 };

const unsigned char ByteRevTable[256] = {
        0x00, 0x80, 0x40, 0xc0, 0x20, 0xa0, 0x60, 0xe0,
        0x10, 0x90, 0x50, 0xd0, 0x30, 0xb0, 0x70, 0xf0,
        0x08, 0x88, 0x48, 0xc8, 0x28, 0xa8, 0x68, 0xe8,
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        0x1f, 0x9f, 0x5f, 0xdf, 0x3f, 0xbf, 0x7f, 0xff,
};

unsigned char BitRev8(unsigned char byte)
{
    return ByteRevTable[byte];
}
